## app/boards/shields/ffkbv3/Kconfig.shield
```kconfig
 #
 # Copyright (c) 2020 The ZMK Contributors
 #
 # SPDX-License-Identifier: MIT
 #

config SHIELD_FFKBV3
    def_bool $(shields_list_contains,ffkbv3)
```
